## main/Kconfig.projbuild
```kconfig
menu "Watch configuration"

    choice EXAMPLE_LCD_CONTROLLER
        prompt "LCD controller model"
        default EXAMPLE_LCD_CONTROLLER_SSD1306
        help
            Select LCD controller model

        config EXAMPLE_LCD_CONTROLLER_SSD1306
            bool "SSD1306"

        config EXAMPLE_LCD_CONTROLLER_SH1107
            bool "SH1107"
    endchoice

    config SNTP_TIME_SERVER
        string "SNTP server name"
        default "pool.ntp.org"
        help
            Hostname of the main SNTP server.

    choice SNTP_TIME_SYNC_METHOD
        prompt "Time synchronization method"
        default SNTP_TIME_SYNC_METHOD_IMMED
        help
            Time synchronization method.

        config SNTP_TIME_SYNC_METHOD_IMMED
            bool "update time immediately when received"
        config SNTP_TIME_SYNC_METHOD_SMOOTH
            bool "update time with smooth method (adjtime)"
        config SNTP_TIME_SYNC_METHOD_CUSTOM
            bool "custom implementation"
    endchoice

    config EXAMPLE_TOUCH_WAKEUP
        bool "Enable touch wake up"
        default y
        depends on SOC_PM_SUPPORT_TOUCH_SENSOR_WAKEUP
        help
            This option enables wake up from deep sleep using touch pads.
            ESP32 - TOUCH8 and TOUCH9, which correspond to GPIO33 and GPIO32.
            ESP32S2/S3 - TOUCH9, which corresponds to GPIO9.

            Note: On ESP32, touch wakeup source can not be used together with ext0 wakeup source.

    config EXAMPLE_EXT0_WAKEUP
        bool "Enable wakeup from GPIO (ext0)"
        default y if !IDF_TARGET_ESP32
        default n if IDF_TARGET_ESP32
        depends on SOC_PM_SUPPORT_EXT0_WAKEUP
        help
            This option enables wake up from deep sleep from GPIO25(ESP32)/GPIO3(ESP32S2,S3). The pin should be
            connected to LOW to avoid being in a floating state. When triggering a wake up, connect the pin to HIGH.
            Note that floating pins may trigger a wake up.

            Note: On ESP32, ext0 wakeup source can not be used together with touch wakeup source.

    config EXAMPLE_EXT1_WAKEUP
        bool "Enable wakeup from GPIO (ext1)"
        default y
        depends on SOC_PM_SUPPORT_EXT1_WAKEUP
        help
            This option enables wake up from deep sleep from GPIO2 and GPIO4. They should be connected to LOW to avoid
            floating pins. When triggering a wake up, connect one or both of the pins to HIGH. Note that floating
            pins may trigger a wake up.

    menu "EXT1 wakeup configuration"
        visible if EXAMPLE_EXT1_WAKEUP

        config EXAMPLE_EXT1_WAKEUP_PIN_1
            int "Enable wakeup from PIN_1"
            depends on !IDF_TARGET_ESP32
            default 2 if !IDF_TARGET_ESP32H2
            default 10 if IDF_TARGET_ESP32H2
            range 0 7 if IDF_TARGET_ESP32C6
            range 7 14 if IDF_TARGET_ESP32H2
            range 0 21 if IDF_TARGET_ESP32S2
            range 0 21 if IDF_TARGET_ESP32S3

        choice EXAMPLE_EXT1_WAKEUP_PIN_1_SEL
            prompt "Enable wakeup from PIN_1"
            default EXAMPLE_EXT1_WAKEUP_PIN_1_SEL_2
            depends on IDF_TARGET_ESP32
            config EXAMPLE_EXT1_WAKEUP_PIN_1_SEL_0
                bool "GPIO 0"
            config EXAMPLE_EXT1_WAKEUP_PIN_1_SEL_2
                bool "GPIO 2"
            config EXAMPLE_EXT1_WAKEUP_PIN_1_SEL_4
                bool "GPIO 4"
            config EXAMPLE_EXT1_WAKEUP_PIN_1_SEL_12
                bool "GPIO 12"
            config EXAMPLE_EXT1_WAKEUP_PIN_1_SEL_13
                bool "GPIO 13"
            config EXAMPLE_EXT1_WAKEUP_PIN_1_SEL_14
                bool "GPIO 14"
            config EXAMPLE_EXT1_WAKEUP_PIN_1_SEL_15
                bool "GPIO 15"
            config EXAMPLE_EXT1_WAKEUP_PIN_1_SEL_25
                bool "GPIO 25"
            config EXAMPLE_EXT1_WAKEUP_PIN_1_SEL_26
                bool "GPIO 26"
            config EXAMPLE_EXT1_WAKEUP_PIN_1_SEL_27
                bool "GPIO 27"
            config EXAMPLE_EXT1_WAKEUP_PIN_1_SEL_32
                bool "GPIO 32"
            config EXAMPLE_EXT1_WAKEUP_PIN_1_SEL_33
                bool "GPIO 33"
            config EXAMPLE_EXT1_WAKEUP_PIN_1_SEL_34
                bool "GPIO 34"
            config EXAMPLE_EXT1_WAKEUP_PIN_1_SEL_35
                bool "GPIO 35"
            config EXAMPLE_EXT1_WAKEUP_PIN_1_SEL_36
                bool "GPIO 36"
            config EXAMPLE_EXT1_WAKEUP_PIN_1_SEL_37
                bool "GPIO 37"
            config EXAMPLE_EXT1_WAKEUP_PIN_1_SEL_38
                bool "GPIO 38"
            config EXAMPLE_EXT1_WAKEUP_PIN_1_SEL_39
                bool "GPIO 39"
        endchoice

        config EXAMPLE_EXT1_WAKEUP_PIN_1
            int
            depends on IDF_TARGET_ESP32
            default 0 if EXAMPLE_EXT1_WAKEUP_PIN_1_SEL_0
            default 2 if EXAMPLE_EXT1_WAKEUP_PIN_1_SEL_2
            default 4 if EXAMPLE_EXT1_WAKEUP_PIN_1_SEL_4
            default 12 if EXAMPLE_EXT1_WAKEUP_PIN_1_SEL_12
            default 13 if EXAMPLE_EXT1_WAKEUP_PIN_1_SEL_13
            default 14 if EXAMPLE_EXT1_WAKEUP_PIN_1_SEL_14
            default 15 if EXAMPLE_EXT1_WAKEUP_PIN_1_SEL_15
            default 25 if EXAMPLE_EXT1_WAKEUP_PIN_1_SEL_25
            default 26 if EXAMPLE_EXT1_WAKEUP_PIN_1_SEL_26
            default 27 if EXAMPLE_EXT1_WAKEUP_PIN_1_SEL_27
            default 32 if EXAMPLE_EXT1_WAKEUP_PIN_1_SEL_32
            default 33 if EXAMPLE_EXT1_WAKEUP_PIN_1_SEL_33
            default 34 if EXAMPLE_EXT1_WAKEUP_PIN_1_SEL_34
            default 35 if EXAMPLE_EXT1_WAKEUP_PIN_1_SEL_35
            default 36 if EXAMPLE_EXT1_WAKEUP_PIN_1_SEL_36
            default 37 if EXAMPLE_EXT1_WAKEUP_PIN_1_SEL_37
            default 38 if EXAMPLE_EXT1_WAKEUP_PIN_1_SEL_38
            default 39 if EXAMPLE_EXT1_WAKEUP_PIN_1_SEL_39

        config EXAMPLE_EXT1_WAKEUP_PIN_2
            int "Enable wakeup from PIN_2"
            depends on !IDF_TARGET_ESP32
            default 4 if !IDF_TARGET_ESP32H2
            default 11 if IDF_TARGET_ESP32H2
            range 0 7 if IDF_TARGET_ESP32C6
            range 7 14 if IDF_TARGET_ESP32H2
            range 0 21 if IDF_TARGET_ESP32S2
            range 0 21 if IDF_TARGET_ESP32S3

        choice EXAMPLE_EXT1_WAKEUP_PIN_2_SEL
            prompt "Enable wakeup from PIN_2"
            default EXAMPLE_EXT1_WAKEUP_PIN_2_SEL_4
            depends on IDF_TARGET_ESP32
            config EXAMPLE_EXT1_WAKEUP_PIN_2_SEL_0
                bool "GPIO 0"
            config EXAMPLE_EXT1_WAKEUP_PIN_2_SEL_2
                bool "GPIO 2"
            config EXAMPLE_EXT1_WAKEUP_PIN_2_SEL_4
                bool "GPIO 4"
            config EXAMPLE_EXT1_WAKEUP_PIN_2_SEL_12
                bool "GPIO 12"
            config EXAMPLE_EXT1_WAKEUP_PIN_2_SEL_13
                bool "GPIO 13"
            config EXAMPLE_EXT1_WAKEUP_PIN_2_SEL_14
                bool "GPIO 14"
            config EXAMPLE_EXT1_WAKEUP_PIN_2_SEL_15
                bool "GPIO 15"
            config EXAMPLE_EXT1_WAKEUP_PIN_2_SEL_25
                bool "GPIO 25"
            config EXAMPLE_EXT1_WAKEUP_PIN_2_SEL_26
                bool "GPIO 26"
            config EXAMPLE_EXT1_WAKEUP_PIN_2_SEL_27
                bool "GPIO 27"
            config EXAMPLE_EXT1_WAKEUP_PIN_2_SEL_32
                bool "GPIO 32"
            config EXAMPLE_EXT1_WAKEUP_PIN_2_SEL_33
                bool "GPIO 33"
            config EXAMPLE_EXT1_WAKEUP_PIN_2_SEL_34
                bool "GPIO 34"
            config EXAMPLE_EXT1_WAKEUP_PIN_2_SEL_35
                bool "GPIO 35"
            config EXAMPLE_EXT1_WAKEUP_PIN_2_SEL_36
                bool "GPIO 36"
            config EXAMPLE_EXT1_WAKEUP_PIN_2_SEL_37
                bool "GPIO 37"
            config EXAMPLE_EXT1_WAKEUP_PIN_2_SEL_38
                bool "GPIO 38"
            config EXAMPLE_EXT1_WAKEUP_PIN_2_SEL_39
                bool "GPIO 39"
        endchoice

        config EXAMPLE_EXT1_WAKEUP_PIN_2
            int
            depends on IDF_TARGET_ESP32
            default 0 if EXAMPLE_EXT1_WAKEUP_PIN_2_SEL_0
            default 2 if EXAMPLE_EXT1_WAKEUP_PIN_2_SEL_2
            default 4 if EXAMPLE_EXT1_WAKEUP_PIN_2_SEL_4
            default 12 if EXAMPLE_EXT1_WAKEUP_PIN_2_SEL_12
            default 13 if EXAMPLE_EXT1_WAKEUP_PIN_2_SEL_13
            default 14 if EXAMPLE_EXT1_WAKEUP_PIN_2_SEL_14
            default 15 if EXAMPLE_EXT1_WAKEUP_PIN_2_SEL_15
            default 25 if EXAMPLE_EXT1_WAKEUP_PIN_2_SEL_25
            default 26 if EXAMPLE_EXT1_WAKEUP_PIN_2_SEL_26
            default 27 if EXAMPLE_EXT1_WAKEUP_PIN_2_SEL_27
            default 32 if EXAMPLE_EXT1_WAKEUP_PIN_2_SEL_32
            default 33 if EXAMPLE_EXT1_WAKEUP_PIN_2_SEL_33
            default 34 if EXAMPLE_EXT1_WAKEUP_PIN_2_SEL_34
            default 35 if EXAMPLE_EXT1_WAKEUP_PIN_2_SEL_35
            default 36 if EXAMPLE_EXT1_WAKEUP_PIN_2_SEL_36
            default 37 if EXAMPLE_EXT1_WAKEUP_PIN_2_SEL_37
            default 38 if EXAMPLE_EXT1_WAKEUP_PIN_2_SEL_38
            default 39 if EXAMPLE_EXT1_WAKEUP_PIN_2_SEL_39

        choice EXAMPLE_EXT1_WAKEUP_MODE_SEL
            prompt "Select wakeup mode from EXT1"
            default ESP_EXT1_WAKEUP_ANY_HIGH
            config ESP_EXT1_WAKEUP_ANY_LOW
                bool "GPIO any low level"
                depends on !IDF_TARGET_ESP32
            config ESP_EXT1_WAKEUP_ALL_LOW
                bool "GPIO all low level"
                depends on IDF_TARGET_ESP32
            config ESP_EXT1_WAKEUP_ANY_HIGH
                bool "GPIO any high level"
        endchoice

        config EXAMPLE_EXT1_WAKEUP_MODE
            int
            default 0 if ESP_EXT1_WAKEUP_ANY_LOW
            default 0 if ESP_EXT1_WAKEUP_ALL_LOW
            default 1 if ESP_EXT1_WAKEUP_ANY_HIGH

        config EXAMPLE_EXT1_USE_INTERNAL_PULLUPS
            bool "Use internal pull-up/downs for EXT1 wakeup source"
            default n
            depends on EXAMPLE_EXT1_WAKEUP
            help
                When using EXT1 wakeup source without external pull-up/downs, you may want to make use of
                the internal ones.

                if we turn off the RTC_PERIPH domain or if certain chips lack the RTC_PERIPH domain,
                we will use the HOLD feature to maintain the pull-up and pull-down on the pins during sleep.
                but if we turn on the RTC_PERIPH domain, we don not need to use HOLD feature and this will
                increase some power comsumption.

                EXT0 wakeup source resides in the same power domain as RTCIO (RTC Periph), so internal
                pull-up/downs are always available. There's no need to explicitly force it on for EXT0.
    endmenu

    config EXAMPLE_GPIO_WAKEUP
        bool "Enable wakeup from GPIO"
        default y
        depends on SOC_GPIO_SUPPORT_DEEPSLEEP_WAKEUP
        help
            This option enables wake up from GPIO. Be aware that if you use low level to trigger wakeup, we strongly
            recommand you to connect external pull-up resistance.

    menu "GPIO wakeup configuration"
        visible if EXAMPLE_GPIO_WAKEUP

        config EXAMPLE_GPIO_WAKEUP_PIN
            int "Enable wakeup from GPIO"
            default 0
            range 0 7 if IDF_TARGET_ESP32C6
            range 0 5 if !IDF_TARGET_ESP32C6

        config EXAMPLE_GPIO_WAKEUP_HIGH_LEVEL
            bool "Enable GPIO high-level wakeup"
            default y
            help
                This option set the gpio wake-up trigger signal, In deep sleep, only high or low level wake-up is
                supported. If this option is enabled, it is a high level wake up, otherwise it is a low level wake up.
    endmenu

    config EXAMPLE_DUMP_ADV_DATA_AND_SCAN_RESP
        bool "Dump whole adv data and scan response data in example"
        default n

	menu "SD-card configuration"

    	config EXAMPLE_FORMAT_IF_MOUNT_FAILED
    	    bool "Format the card if mount failed"
    	    default n
    	    help
    	        If this config item is set, format_if_mount_failed will be set to true and the card will be formatted if
    	        the mount has failed.

    	config EXAMPLE_FORMAT_SD_CARD
    	    bool "Format the card as a part of the example"
    	    default n
    	    help
    	        If this config item is set, the card will be formatted as a part of the example.

    	config EXAMPLE_PIN_MOSI
    	    int "MOSI GPIO number"
    	    default 15 if IDF_TARGET_ESP32
    	    default 35 if IDF_TARGET_ESP32S2
    	    default 4 if IDF_TARGET_ESP32S3
    	    default 5  if IDF_TARGET_ESP32H2
    	    default 36 if IDF_TARGET_ESP32P4
    	    default 4  # C3 and others

    	config EXAMPLE_PIN_MISO
    	    int "MISO GPIO number"
    	    default 2 if IDF_TARGET_ESP32
    	    default 37 if IDF_TARGET_ESP32S2
    	    default 5 if IDF_TARGET_ESP32S3
    	    default 0  if IDF_TARGET_ESP32H2
    	    default 47 if IDF_TARGET_ESP32P4
    	    default 6  # C3 and others

    	config EXAMPLE_PIN_CLK
    	    int "CLK GPIO number"
    	    default 14 if IDF_TARGET_ESP32
    	    default 36 if IDF_TARGET_ESP32S2
    	    default 2 if IDF_TARGET_ESP32S3
    	    default 4  if IDF_TARGET_ESP32H2
    	    default 53 if IDF_TARGET_ESP32P4
    	    default 5  # C3 and others

    	config EXAMPLE_PIN_CS
    	    int "CS GPIO number"
    	    default 13 if IDF_TARGET_ESP32
    	    default 34 if IDF_TARGET_ESP32S2
    	    default 8 if IDF_TARGET_ESP32S3
    	    default 33 if IDF_TARGET_ESP32P4
    	    default 1  # C3 and others

    	config EXAMPLE_DEBUG_PIN_CONNECTIONS
    	    bool "Debug sd pin connections and pullup strength"
    	    default n

    	config EXAMPLE_ENABLE_ADC_FEATURE
    	    bool "Enable ADC feature"
    	    depends on EXAMPLE_DEBUG_PIN_CONNECTIONS
    	    default y if IDF_TARGET_ESP32
    	    default n

    	config EXAMPLE_ADC_UNIT
    	    int "ADC Unit"
    	    depends on EXAMPLE_DEBUG_PIN_CONNECTIONS
    	    default 1 if IDF_TARGET_ESP32
    	    default 0 if IDF_TARGET_ESP32S3
    	    default 1

    	config EXAMPLE_ADC_PIN_MOSI
    	    int "MOSI mapped ADC pin"
    	    depends on EXAMPLE_ENABLE_ADC_FEATURE
    	    default 3 if IDF_TARGET_ESP32
    	    default 7 if IDF_TARGET_ESP32S3
    	    default 1

    	config EXAMPLE_ADC_PIN_MISO
    	    int "MISO mapped ADC pin"
    	    depends on EXAMPLE_ENABLE_ADC_FEATURE
    	    default 2 if IDF_TARGET_ESP32
    	    default 1 if IDF_TARGET_ESP32S3
    	    default 1

    	config EXAMPLE_ADC_PIN_CLK
    	    int "CLK mapped ADC pin"
    	    depends on EXAMPLE_ENABLE_ADC_FEATURE
    	    default 6 if IDF_TARGET_ESP32
    	    default 0 if IDF_TARGET_ESP32S3
    	    default 1

    	config EXAMPLE_ADC_PIN_CS
    	    int "CS mapped ADC pin"
    	    depends on EXAMPLE_ENABLE_ADC_FEATURE
    	    default 4 if IDF_TARGET_ESP32
    	    default 6 if IDF_TARGET_ESP32S3
    	    default 1

    	config EXAMPLE_SD_PWR_CTRL_LDO_INTERNAL_IO
    	    depends on SOC_SDMMC_IO_POWER_EXTERNAL
    	    bool "SD power supply comes from internal LDO IO (READ HELP!)"
    	    default n
    	    help
    	        Only needed when the SD card is connected to specific IO pins which can be used for high-speed SDMMC.
    	        Please read the schematic first and check if the SD VDD is connected to any internal LDO output.
    	        Unselect this option if the SD card is powered by an external power supply.

    	config EXAMPLE_SD_PWR_CTRL_LDO_IO_ID
    	    depends on SOC_SDMMC_IO_POWER_EXTERNAL && EXAMPLE_SD_PWR_CTRL_LDO_INTERNAL_IO
    	    int "LDO ID"
    	    default 4 if IDF_TARGET_ESP32P4
    	    help
    	        Please read the schematic first and input your LDO ID.

	endmenu

	menu "Buttons config"	

    	orsource "$IDF_PATH/examples/common_components/env_caps/$IDF_TARGET/Kconfig.env_caps"

    	config GPIO_INPUT_0
    	    int "GPIO input pin 0"
    	    range ENV_GPIO_RANGE_MIN ENV_GPIO_IN_RANGE_MAX
    	    default 25 
    	    help
    	        GPIO pin number to be used as GPIO_INPUT_IO_0.

    	config GPIO_INPUT_1
    	    int "GPIO input pin 1"
    	    range ENV_GPIO_RANGE_MIN ENV_GPIO_IN_RANGE_MAX
    	    default 26 
    	    help
    	        GPIO pin number to be used as GPIO_INPUT_IO_1.

    	config GPIO_INPUT_2
    	    int "GPIO input pin 2"
    	    range ENV_GPIO_RANGE_MIN ENV_GPIO_IN_RANGE_MAX
    	    default 32 
    	    help
    	        GPIO pin number to be used as GPIO_INPUT_IO_2.

    	config GPIO_INPUT_3
    	    int "GPIO input pin 3"
    	    range ENV_GPIO_RANGE_MIN ENV_GPIO_IN_RANGE_MAX
    	    default 33 
    	    help
    	        GPIO pin number to be used as GPIO_INPUT_IO_3.

	endmenu

endmenu
```
